// SPDX-FileCopyrightText: 2026 The weft authors
// SPDX-License-Identifier: MIT
//
// A Raspberry Pi style overlay: ADS1115 with ADDR to GND (0x48) on i2c1.
/dts-v1/;
/plugin/;

&i2c1 {
	#address-cells = <1>;
	#size-cells = <0>;
	status = "okay";

	adc: adc@48 {
		compatible = "ti,ads1115";
		reg = <0x48>;
	};
};
